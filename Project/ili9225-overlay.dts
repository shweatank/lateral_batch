/dts-v1/;
/plugin/;

/ {
    compatible = "brcm,bcm2835";

    fragment@0 {
        target = <&spi0>;
        _overlay_ {
            status = "okay";

            ili9225@0 {
                compatible = "ilitek,ili9225";
                reg = <0>;
                spi-max-frequency = <16000000>;
                dc-gpios = <&gpio 25 0>;
                reset-gpios = <&gpio 24 0>;
                status = "okay";
            };
        };
    };
};
