/dts-v1/;
/plugin/;

/ {
    compatible = "brcm,bcm2711"; // Adjust for your Pi version if needed

    fragment@0 {
        target-path = "/";
        __overlay__ {
            my_blink_device {
                compatible = "udaybhaskar,td-gpio-blink";
                in-gpios = <&gpio 17 0>;  /* GPIO 17 Input */
                out-gpios = <&gpio 27 0>; /* GPIO 27 Output */
                status = "okay";
            };
        };
    };
};
